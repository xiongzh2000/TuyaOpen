## apps/tuya.ai/pai_xue_ji/Kconfig
```kconfig
menu "configure app (pai_xue_ji) "

config TUYA_PRODUCT_ID
    string "product ID of project"
    default "p320pepzvmm1ghse"

rsource "../ai_components/Kconfig"

endmenu
```

## apps/tuya.ai/smart_badge/Kconfig
```kconfig
menu "configure app (smart_badge)"

config TUYA_PRODUCT_ID
    string "product ID of project"
    default "xur0x7figstx1ubq"

rsource "../ai_components/Kconfig"

endmenu
```

## apps/tuya.ai/your_photo_ai/Kconfig
```kconfig
menu "configure app (your_photo_ai)"

config TUYA_PRODUCT_ID
    string "product ID"
    default "your_product_id_here"

rsource "../ai_components/Kconfig"

endmenu
```

## boards/ESP32/WAVESHARE_ESP32P4_Touch_LCD_4.3/Kconfig
```kconfig
config CHIP_CHOICE
    string
    default "esp32p4"

config BOARD_CHOICE
    string
    default "WAVESHARE_ESP32P4_Touch_LCD_4.3"

config BOARD_CONFIG
    bool
    default y
    select PLATFORM_FLASHSIZE_32M
    select ENABLE_EXT_RAM
    select ENABLE_AUDIO
    select ENABLE_BUTTON
    select ENABLE_DISPLAY
    select ENABLE_TP

config UART_NUM0_TX_PIN
    int "UART_NUM0_TX_PIN"
    range 0 54
    default 37

config UART_NUM0_RX_PIN
    int "UART_NUM0_RX_PIN"
    range 0 54
    default 38
```

## boards/ESP32/WAVESHARE_ESP32S3_Touch_LCD_7/Kconfig
```kconfig
config CHIP_CHOICE
    string
    default "esp32s3"

config BOARD_CHOICE
    string
    default "WAVESHARE_ESP32S3_Touch_LCD_7"

config BOARD_CONFIG
    bool
    default y
    select ENABLE_EXT_RAM
    select ENABLE_AUDIO
    select ENABLE_BUTTON
    select ENABLE_DISPLAY
    select ENABLE_TP
    select PLATFORM_FLASHSIZE_16M
    select ENABLE_ESP32S3_USB_JTAG_ONLY
```
